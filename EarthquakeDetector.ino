/* Earthquake Detector with Email Alerts (ESP32 Version, Final)
 * Features:
 * - MPU-6050 Vibration Detection
 * - Richter Scale Estimation
 * - Buzzer + LED Alerts
 * - Email Notifications (safe failure)
 * - Serial Output
 * - No Hang if WiFi/SMTP fails
 */

#include <Wire.h>
#include <WiFi.h>
#include <ESP_Mail_Client.h>

#define WIFI_SSID       "YOUR_SSID"
#define WIFI_PASSWORD   "YOUR_PASSWORD"
#define SMTP_HOST       "smtp.gmail.com"
#define SMTP_PORT       465
#define AUTHOR_EMAIL    "your_email@gmail.com"
#define AUTHOR_PASSWORD "your_email_password"
#define RECIPIENT_EMAIL "recipient@example.com"

#define MPU_ADDR             0x68
#define EARTHQUAKE_THRESHOLD 1.5f
#define RICHTER_CONSTANT     2.0f
#define EMAIL_COOLDOWN       (5 * 60 * 1000UL)

const uint8_t BUZZER_PIN = 26;
const uint8_t LED_PIN    = 25;

unsigned long lastEmailTime = 0;
bool emailOnCooldown = false;

void connectWiFi();
float readSensor();
float calculateRichter(float pga);
void triggerAlarm();
bool sendEmailAlert(float magnitude, float intensity);

void setup() {
  Serial.begin(115200);
  pinMode(BUZZER_PIN, OUTPUT);
  pinMode(LED_PIN, OUTPUT);
  digitalWrite(BUZZER_PIN, LOW);
  digitalWrite(LED_PIN, LOW);

  Wire.begin();
  Wire.beginTransmission(MPU_ADDR);
  Wire.write(0x6B);
  Wire.write(0);
  Wire.endTransmission(true);

  connectWiFi();
}

void loop() {
  float intensity = readSensor();

  if (intensity > EARTHQUAKE_THRESHOLD) {
    float magnitude = calculateRichter(intensity);

    triggerAlarm();
    Serial.printf("[Earthquake Detected] Intensity: %.2f m/s², Magnitude: %.2f\n", intensity, magnitude);

    if (!emailOnCooldown && magnitude > 0) {
      bool emailSent = sendEmailAlert(magnitude, intensity);
      Serial.println(emailSent ? "[Email] Alert sent successfully!" : "[Email] Failed to send alert!");
      lastEmailTime = millis();
      emailOnCooldown = true;
    }
  }

  if (emailOnCooldown && (millis() - lastEmailTime > EMAIL_COOLDOWN)) {
    emailOnCooldown = false;
  }

  delay(100);
}

void connectWiFi() {
  Serial.printf("Connecting to WiFi %s", WIFI_SSID);
  WiFi.mode(WIFI_STA);
  WiFi.begin(WIFI_SSID, WIFI_PASSWORD);

  unsigned long startAttemptTime = millis();
  while (WiFi.status() != WL_CONNECTED && millis() - startAttemptTime < 15000) {
    Serial.print(".");
    delay(500);
  }

  if (WiFi.status() == WL_CONNECTED) {
    Serial.printf("\nWiFi connected! IP Address: %s\n", WiFi.localIP().toString().c_str());
  } else {
    Serial.println("\nWiFi connection failed.");
  }
}

float readSensor() {
  int16_t accelX, accelY, accelZ;
  
  Wire.beginTransmission(MPU_ADDR);
  Wire.write(0x3B);
  Wire.endTransmission(false);
  Wire.requestFrom(MPU_ADDR, 6, true);

  accelX = Wire.read() << 8 | Wire.read();
  accelY = Wire.read() << 8 | Wire.read();
  accelZ = Wire.read() << 8 | Wire.read();

  float ax = accelX / 16384.0 * 9.81;
  float ay = accelY / 16384.0 * 9.81;
  float az = accelZ / 16384.0 * 9.81;

  float totalAcceleration = sqrt(ax * ax + ay * ay + az * az) - 9.81;
  return abs(totalAcceleration);
}

float calculateRichter(float pga) {
  float pga_cm = pga * 100;
  return (pga_cm > 0.1f) ? (log10(pga_cm) + RICHTER_CONSTANT) : 0.0f;
}

void triggerAlarm() {
  for (int i = 0; i < 5; i++) {
    digitalWrite(BUZZER_PIN, HIGH);
    digitalWrite(LED_PIN, HIGH);
    delay(200);
    digitalWrite(BUZZER_PIN, LOW);
    digitalWrite(LED_PIN, LOW);
    delay(200);
  }
}

bool sendEmailAlert(float magnitude, float intensity) {
  if (WiFi.status() != WL_CONNECTED) {
    Serial.println("[WiFi] Not connected, skipping email.");
    return false;
  }

  ESP_Mail_Session config;
  config.server.host_name = SMTP_HOST;
  config.server.port = SMTP_PORT;
  config.login.email = AUTHOR_EMAIL;
  config.login.password = AUTHOR_PASSWORD;
  config.login.user_domain = "";
  config.time.ntp_server = "pool.ntp.org";

  SMTP_Message message;
  message.sender.name = "Earthquake Detector";
  message.sender.email = AUTHOR_EMAIL;
  message.subject = "EARTHQUAKE ALERT!";
  message.addRecipient("Recipient", RECIPIENT_EMAIL);

  char content[300];
  snprintf(content, sizeof(content),
    "<div style='color:#ff0000;'><h2>Earthquake Detected!</h2>"
    "<p><strong>Magnitude:</strong> %.1f</p>"
    "<p><strong>Intensity:</strong> %.2f m/s²</p>"
    "<p><small>Generated by ESP32 Detector</small></p></div>",
    magnitude, intensity
  );

  message.html.content = content;
  message.text.charSet = "us-ascii";
  message.html.transfer_encoding = Content_Transfer_Encoding::enc_7bit;

  SMTPSession smtp;
  if (!smtp.connect(&config)) {
    Serial.println("[SMTP] Connection failed.");
    return false;
  }

  if (!MailClient.sendMail(&smtp, &message)) {
    Serial.println("[SMTP] Sending failed: " + smtp.errorReason());
    return false;
  }

  return true;
}